## boards/shields/piantor/Kconfig.defconfig
```kconfig
if SHIELD_PIANTOR_LEFT

config ZMK_KEYBOARD_NAME
    default "Piantor"

config ZMK_SPLIT_ROLE_CENTRAL
    default y

endif

if SHIELD_PIANTOR_LEFT || SHIELD_PIANTOR_RIGHT

config ZMK_SPLIT
    default y

endif
```

## boards/shields/piantor/Kconfig.shield
```kconfig
config SHIELD_PIANTOR_LEFT
    def_bool $(shields_list_contains,piantor_left)

config SHIELD_PIANTOR_RIGHT
    def_bool $(shields_list_contains,piantor_right)
```

## config/keyboards/artemis/shields/artemis/Kconfig.defconfig
```kconfig
# Copyright (c) 2020 The ZMK Contributors
# SPDX-License-Identifier: MIT

if SHIELD_ARTEMIS_LEFT

config ZMK_KEYBOARD_NAME
	default "Artemis"

config ZMK_SPLIT_BLE_ROLE_CENTRAL
	default y

endif

if SHIELD_ARTEMIS_RIGHT || SHIELD_ARTEMIS_LEFT

config ZMK_SPLIT
	default y

endif
```

## config/keyboards/hillside/shields/hillside/Kconfig.shield
```kconfig
config SHIELD_HILLSIDE_LEFT
    def_bool $(shields_list_contains,hillside_left)

config SHIELD_HILLSIDE_RIGHT
    def_bool $(shields_list_contains,hillside_right)
```
