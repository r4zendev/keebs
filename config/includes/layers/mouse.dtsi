#ifdef LUNA
ZMK_LAYER(Mouse,
    &none &none &none &none &none
    &msc SCRL_DOWN &msc SCRL_LEFT &mmv MOVE_UP &msc SCRL_RIGHT &kp PG_UP
    &kp LGUI &kp LALT &kp LCTRL &kp LSHFT &none
    &none &mmv MOVE_LEFT &mmv MOVE_DOWN &mmv MOVE_RIGHT &kp PG_DN
    &none &none &none
    &mkp MCLK &none &mkp MB4
    &none &mouse_ht LAYER_Mouse LAYER_Mouse &mkp LCLK &mkp RCLK
)
#else
ZMK_BASE_LAYER(Mouse,
//╭──────────┬──────────┬──────────┬──────────┬──────────╮   ╭──────────┬──────────┬──────────┬──────────┬──────────╮
    &none      &none      &none      &none      &none      ,  &msc SCRL_UP &msc SCRL_LEFT &mmv MOVE_UP &msc SCRL_RIGHT &kp PG_UP ,
//├──────────┼──────────┼──────────┼──────────┼──────────┤   ├──────────┼──────────┼──────────┼──────────┼──────────┤
    &kp LGUI   &kp LALT   &kp LCTRL  &kp LSHFT  &none      ,  &msc SCRL_DOWN &mmv MOVE_LEFT &mmv MOVE_DOWN &mmv MOVE_RIGHT &kp PG_DN ,
//├──────────┼──────────┼──────────┼──────────┼──────────┤   ├──────────┼──────────┼──────────┼──────────┼──────────┤
    &none      &none      &none      &none      &none      ,  &none      &mkp MCLK  &none      &mkp MB4   &mkp MB5  ,
//╰──────────┴──────────┴──────────┼──────────┼──────────┤   ├──────────┼──────────┼──────────┴──────────┴──────────╯
                                     LH_NONE &none  &mouse_ht LAYER_Mouse LAYER_Mouse ,  &mkp LCLK  &mkp RCLK RH_NONE
//                                 ╰──────────┴──────────╯   ╰──────────┴──────────╯
)
#endif
