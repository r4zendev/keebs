#ifndef SYS_LIGHT_TOG
#define SYS_LIGHT_TOG &none
#endif

#ifndef SYS_LIGHT_DEC
#define SYS_LIGHT_DEC &none
#endif

#ifndef SYS_LIGHT_INC
#define SYS_LIGHT_INC &none
#endif

#ifdef LUNA
ZMK_LAYER(System,
    &bootloader &to_graphite SYS_SLOT1 SYS_SLOT2 &bt_3
    &soft_off SYS_LIGHT_DEC SYS_LIGHT_INC &none &bootloader
    &bt BT_CLR &bt_0 &bt_1 &bt_2 &none
    &none &kp _LOCK &kp _SHUTDOWN &kp _SLEEP &out OUT_TOG
    &none &none &kp CAPS
    &none &none &none
    &none &none &none &none
)
#else
ZMK_BASE_LAYER(System,
//╭──────────┬──────────┬──────────┬──────────┬──────────╮   ╭──────────┬──────────┬──────────┬──────────┬──────────╮
    &bootloader &to_graphite SYS_SLOT1  SYS_SLOT2  SYS_SLOT3 ,  SYS_LIGHT_TOG SYS_LIGHT_DEC SYS_LIGHT_INC &none      &bootloader ,
//├──────────┼──────────┼──────────┼──────────┼──────────┤   ├──────────┼──────────┼──────────┼──────────┼──────────┤
    &bt BT_CLR &bt_0      &bt_1      &bt_2      &bt_3      ,  &soft_off  &kp _LOCK  &kp _SHUTDOWN &kp _SLEEP &out OUT_TOG ,
//├──────────┼──────────┼──────────┼──────────┼──────────┤   ├──────────┼──────────┼──────────┼──────────┼──────────┤
    &sys_reset &none      &none      &kp CAPS   &none      ,  &none      &none      &none      &none      &sys_reset ,
//╰──────────┴──────────┴──────────┼──────────┼──────────┤   ├──────────┼──────────┼──────────┴──────────┴──────────╯
                                     LH_NONE &none      &none      ,  &none      &none RH_NONE
//                                 ╰──────────┴──────────╯   ╰──────────┴──────────╯
)
#endif
