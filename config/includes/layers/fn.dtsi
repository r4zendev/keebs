#ifdef LUNA
ZMK_LAYER(Fn,
    &kp F12 &kp F7 &kp F8 &kp F9 &kp C_PP
    &none &none &none &none &none
    &kp F11 &kp F4 &kp F5 &kp F6 &kp C_NEXT
    &none &kp RSHFT &kp RCTRL &kp RALT &kp RGUI
    &kp F1 &kp F2 &kp F3
    &none &none &none
    &kp C_MUTE &kp LG(F9) &trans &trans
)
#else
ZMK_BASE_LAYER(Fn,
//╭──────────┬──────────┬──────────┬──────────┬──────────╮   ╭──────────┬──────────┬──────────┬──────────┬──────────╮
    &kp F12    &kp F7     &kp F8     &kp F9     &kp C_PREV ,  &none      &none      &none      &none      &none     ,
//├──────────┼──────────┼──────────┼──────────┼──────────┤   ├──────────┼──────────┼──────────┼──────────┼──────────┤
    &kp F11    &kp F4     &kp F5     &kp F6     &kp C_PP   ,  &none      &kp RSHFT  &kp RCTRL  &kp RALT   &kp RGUI  ,
//├──────────┼──────────┼──────────┼──────────┼──────────┤   ├──────────┼──────────┼──────────┼──────────┼──────────┤
    &kp F10    &kp F1     &kp F2     &kp F3     &kp C_NEXT ,  &none      &none      &none      &none      &none     ,
//╰──────────┴──────────┴──────────┼──────────┼──────────┤   ├──────────┼──────────┼──────────┴──────────┴──────────╯
                                     LH_NONE &kp C_MUTE &kp LG(F9) ,  &trans     &trans RH_NONE
//                                 ╰──────────┴──────────╯   ╰──────────┴──────────╯
)
#endif
