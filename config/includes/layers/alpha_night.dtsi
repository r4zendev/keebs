/* Night — left-thumb alpha (r), right-thumb space. Inactive by default. */

/* >>> generated adaptive swaps (do not edit — run ./scripts/generate) >>> */
#include "../generated/alpha_night.dtsi"
/* <<< end generated adaptive swaps <<< */

/* yq -> y' : dead-key redirect to a symbol (one-way by necessity, not a swap). */
#if NIGHT_ADAPTIVE
ZMK_ADAPTIVE_KEY(night_bigram_q, bindings = <&kp Q>;
    night_q_y { trigger-keys = <Y>; max-prior-idle-ms = <ADAPTIVE_TIMEOUT_MS>; bindings = <&kp SQT>; strict-modifiers; };
)
#define NIGHT_Q &night_bigram_q
#endif

#ifndef NIGHT_E
#define NIGHT_E &hmr RALT E
#endif
#ifndef NIGHT_O
#define NIGHT_O &kp O
#endif
#ifndef NIGHT_Q
#define NIGHT_Q &kp Q
#endif

ZMK_BASE_LAYER(Night,
//╭──────────┬──────────┬──────────┬──────────┬──────────╮   ╭──────────┬──────────┬──────────┬──────────┬──────────╮
    &kp B      &kp F      &kp L      &kp D      NIGHT_Q    ,  &kp P      &kp G      NIGHT_O    &kp U      &dot_qmark ,
//├──────────┼──────────┼──────────┼──────────┼──────────┤   ├──────────┼──────────┼──────────┼──────────┼──────────┤
   &hml LGUI N &hml LALT S &hml LCTRL H &hml LSHFT T &kp M , &kp Y      &hmr RSHFT C &hmr RCTRL A NIGHT_E &hmr RGUI I ,
//├──────────┼──────────┼──────────┼──────────┼──────────┤   ├──────────┼──────────┼──────────┼──────────┼──────────┤
    &kp X      &kp V      &kp J      &kp K      &kp Z      ,  &sqt_dqt   &kp W      &kp SEMI   &minus_slash &comma_excl ,
//╰──────────┴──────────┴──────────┼──────────┼──────────┤   ├──────────┼──────────┼──────────┴──────────┴──────────╯
        LH_NONE &thumb_bspc LAYER_Nav 0  &thumb_spc LAYER_Mouse R , &thumb_spc LAYER_Symbol SPACE  &num_repeat LAYER_Num 0 RH_NONE
//                                 ╰──────────┴──────────╯   ╰──────────┴──────────╯
)
