#ifdef LUNA
ZMK_LAYER(VestnikX,
    &none &none &none &none &none
    &none &kp A &kp RBKT &none &none
    &none &none &none &none &none
    &kp GRAVE &kp LBKT &kp O &kp W &kp SQT
    &none &none &none
    &none &none &none
    &trans &trans &trans &trans
)
#else
ZMK_BASE_LAYER(VestnikX,
//╭──────────┬──────────┬──────────┬──────────┬──────────╮   ╭──────────┬──────────┬──────────┬──────────┬──────────╮
    &none      &none      &none      &none      &none      ,  &none      &none      &kp RBKT   &none      &none     ,
//├──────────┼──────────┼──────────┼──────────┼──────────┤   ├──────────┼──────────┼──────────┼──────────┼──────────┤
    &none      &none      &none      &none      &none      ,  &kp GRAVE  &none      &kp O      &none      &none     ,
//├──────────┼──────────┼──────────┼──────────┼──────────┤   ├──────────┼──────────┼──────────┼──────────┼──────────┤
    &none      &none      &none      &none      &none      ,  &none      &none      &none      &none      &none     ,
//╰──────────┴──────────┴──────────┼──────────┼──────────┤   ├──────────┼──────────┼──────────┴──────────┴──────────╯
                                     LH_NONE &trans     &trans      ,  &trans     &trans RH_NONE
//                                 ╰──────────┴──────────╯   ╰──────────┴──────────╯
)
#endif
