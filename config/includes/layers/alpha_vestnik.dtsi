#ifdef LUNA
ZMK_LAYER(VestnikDm,
    &kp I &kp U &kp H &kp COMMA &kp V
    &kp M &kp G &kp F &kp Z &kp DOT
    &kp C &kp N &kp Y &kp R &kp X
    &kp SEMI &kp D &kp J &kp T &kp B
    &kp P &kp K &kp L
    &kp Q &kp S &kp E
    VESTNIK_THUMBS_L
    ALPHA_THUMBS_R
)
#else
ZMK_BASE_LAYER(VestnikDm,
//╭──────────┬──────────┬──────────┬──────────┬──────────╮   ╭──────────┬──────────┬──────────┬──────────┬──────────╮
    &kp W      &kp U      &kp H      &kp COMMA  &kp LBKT   ,  &kp A      &kp G      &kp F      &kp Z      &kp SQT  ,
//├──────────┼──────────┼──────────┼──────────┼──────────┤   ├──────────┼──────────┼──────────┼──────────┼──────────┤
    &hml LGUI C &hml LALT N &hml LCTRL Y &hml LSHFT R &kp V , &kp M  &hmr RSHFT D &hmr RCTRL J &hmr RALT T &hmr RGUI B ,
//├──────────┼──────────┼──────────┼──────────┼──────────┤   ├──────────┼──────────┼──────────┼──────────┼──────────┤
    &kp I      &kp P      &kp K      &kp L      &kp X      ,  &kp SEMI   &kp Q      &kp S      &kp E      &kp DOT  ,
//╰──────────┴──────────┴──────────┼──────────┼──────────┤   ├──────────┼──────────┼──────────┴──────────┴──────────╯
            LH_NONE VESTNIK_THUMBS_L , ALPHA_THUMBS_R RH_NONE
//                                 ╰──────────┴──────────╯   ╰──────────┴──────────╯
)
#endif
