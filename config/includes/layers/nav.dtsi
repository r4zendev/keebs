#ifdef LUNA
ZMK_LAYER(Nav,
    &kp ESC &kp LG(O) &kp LG(U) &kp C_PREV &kp C_PP
    &kp PG_DN &kp _HOME &kp UP &kp _END &lang_ru
    &kp LGUI &kp LALT &kp LCTRL &kp LSHFT &kp C_NEXT
    &none &kp LEFT &kp DOWN &kp RIGHT &lang_en
    &kp _SCR_AREA &kp _SCR_FULL &none
    &kp TAB &kp BSPC &kp DEL
    &none &mouse_ht LAYER_Mouse LAYER_Mouse &kp RET &none
)
#else
ZMK_BASE_LAYER(Nav,
//╭──────────┬──────────┬──────────┬──────────┬──────────╮   ╭──────────┬──────────┬──────────┬──────────┬──────────╮
    &kp ESC   &kp LG(O)  &kp LG(U)  &kp C_PREV &kp C_PP   , &kp PG_UP   &kp _HOME  &kp UP     &kp _END   &lang_ru  ,
//├──────────┼──────────┼──────────┼──────────┼──────────┤   ├──────────┼──────────┼──────────┼──────────┼──────────┤
    &kp LGUI   &kp LALT   &kp LCTRL  &kp LSHFT  &kp C_NEXT ,  &kp PG_DN  &kp LEFT   &kp DOWN   &kp RIGHT  &lang_en  ,
//├──────────┼──────────┼──────────┼──────────┼──────────┤   ├──────────┼──────────┼──────────┼──────────┼──────────┤
   &kp LG(LA(S)) &kp _SCR_AREA &kp _SCR_FULL &none     &none , &none      &kp TAB    &kp BSPC   &kp DEL    &none     ,
//╰──────────┴──────────┴──────────┼──────────┼──────────┤   ├──────────┼──────────┼──────────┴──────────┴──────────╯
                                     LH_NONE &none  &mouse_ht LAYER_Mouse LAYER_Mouse , &kp RET    &none RH_NONE
//                                 ╰──────────┴──────────╯   ╰──────────┴──────────╯
)
#endif
