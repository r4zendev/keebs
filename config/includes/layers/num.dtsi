#ifdef LUNA
ZMK_LAYER(Num,
    &kp UNDER &fnum F7 N7 &fnum F8 N8 &fnum F9 N9 &kp PLUS
    &kp F11 &kp F12 &none &none &none
    &kp DOT &fnum F4 N4 &fnum F5 N5 &fnum F6 N6 &kp COLON
    &none &kp RSHFT &kp RCTRL &kp RALT &kp RGUI
    &fnum F1 N1 &fnum F2 N2 &fnum F3 N3
    &kp COMMA &kp EQUAL &kp MINUS
    &trans &fnum F10 N0 &trans &trans
)
#else
ZMK_BASE_LAYER(Num,
//╭──────────┬──────────┬──────────┬──────────┬──────────╮   ╭──────────┬──────────┬──────────┬──────────┬──────────╮
    &kp UNDER  &fnum F7 N7 &fnum F8 N8 &fnum F9 N9 &kp PLUS ,  &kp F11    &kp F12    &none      &none      &none     ,
//├──────────┼──────────┼──────────┼──────────┼──────────┤   ├──────────┼──────────┼──────────┼──────────┼──────────┤
    &kp DOT    &fnum F4 N4 &fnum F5 N5 &fnum F6 N6 &kp COLON , &none      &kp RSHFT  &kp RCTRL  &kp RALT   &kp RGUI  ,
//├──────────┼──────────┼──────────┼──────────┼──────────┤   ├──────────┼──────────┼──────────┼──────────┼──────────┤
    &kp STAR   &fnum F1 N1 &fnum F2 N2 &fnum F3 N3 &kp FSLH ,  &kp COMMA  &kp EQUAL  &kp PRCNT  &kp MINUS  &none     ,
//╰──────────┴──────────┴──────────┼──────────┼──────────┤   ├──────────┼──────────┼──────────┴──────────┴──────────╯
                                     LH_NONE &trans     &fnum F10 N0 ,  &trans     &trans RH_NONE
//                                 ╰──────────┴──────────╯   ╰──────────┴──────────╯
)
#endif
