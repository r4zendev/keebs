#ifdef LUNA
ZMK_LAYER(Symbol,
    &none &kp DLLR &kp PRCNT &kp CARET &none
    &kp TILDE &kp LBRC &kp RBRC &kp AT &kp GRAVE
    &kp LGUI &kp LALT &kp LCTRL &kp LSHFT &none
    &kp COLON &kp LPAR &kp RPAR &kp SEMI &kp DQT
    &kp AMPS &kp PIPE &kp BSLH
    &kp LBKT &kp RBKT &kp QMARK
    &trans &trans &kp SPACE &trans
)
#else
ZMK_BASE_LAYER(Symbol,
//╭──────────┬──────────┬──────────┬──────────┬──────────╮   ╭──────────┬──────────┬──────────┬──────────┬──────────╮
    &none      &kp DLLR   &kp PRCNT  &kp CARET  &none      ,  &kp TILDE  &kp LBRC   &kp RBRC   &kp AT     &kp GRAVE ,
//├──────────┼──────────┼──────────┼──────────┼──────────┤   ├──────────┼──────────┼──────────┼──────────┼──────────┤
    &kp LGUI   &kp LALT   &kp LCTRL  &kp LSHFT  &none      ,  &kp COLON  &kp LPAR   &kp RPAR   &kp SEMI   &kp DQT   ,
//├──────────┼──────────┼──────────┼──────────┼──────────┤   ├──────────┼──────────┼──────────┼──────────┼──────────┤
    &none      &kp AMPS   &kp PIPE   &kp BSLH   &none      ,  &kp EXCL   &kp LBKT   &kp RBKT   &kp QMARK  &kp SQT   ,
//╰──────────┴──────────┴──────────┼──────────┼──────────┤   ├──────────┼──────────┼──────────┴──────────┴──────────╯
                                     LH_NONE &trans     &trans      ,  &kp SPACE  &trans RH_NONE
//                                 ╰──────────┴──────────╯   ╰──────────┴──────────╯
)
#endif
