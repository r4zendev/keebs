/* 30-key setup (Luna and friends): 5+5 top, 5+5 home, 3+3 bottom, 2+2 thumbs.
 *
 * Remaps the zmk-helpers 36-key labels onto a reduced 30-key matrix. Top and
 * home rows keep their 36.h positions (0-19); the bottom row drops to 3 keys
 * per hand (positions 20-25) and thumbs move to 26-29. Layouts switch to their
 * 30-key arrangement by guarding on the LUNA flag this file defines.
 *
 *   ╭───────────────┬───────────────╮
 *   │ 0  1  2  3  4 │ 5  6  7  8  9 │   top    (LT/RT, unchanged from 36.h)
 *   │10 11 12 13 14 │15 16 17 18 19 │   home   (LM/RM, unchanged from 36.h)
 *   │   20 21 22    │   23 24 25    │   bottom (LB0-2 / RB0-2)
 *   ╰─────╮ 26 27   │   28 29 ╭─────╯   thumbs (LH2 LH1 / RH1 RH2)
 */

#include <zmk-helpers/key-labels/36.h>

/* Bottom row: 3 keys/hand. Left 20-22 (outer→inner), right 23-25 (inner→outer). */
#undef LB0
#undef LB1
#undef LB2
#undef LB3
#undef LB4
#define LB2 20
#define LB1 21
#define LB0 22
#undef RB0
#undef RB1
#undef RB2
#undef RB3
#undef RB4
#define RB0 23
#define RB1 24
#define RB2 25

/* Thumbs: 2 keys/hand (positions 26-29), mirroring the 34-key arrangement. */
#undef LH0
#undef LH1
#undef LH2
#undef RH0
#undef RH1
#undef RH2
#define LH2 26
#define LH1 27
#define RH1 28
#define RH2 29

/* Hold-trigger key sets for the reduced grid (only 3 bottom keys per hand). */
#undef KEYS_L
#undef KEYS_R
#define KEYS_L LT0 LT1 LT2 LT3 LT4  LM0 LM1 LM2 LM3 LM4  LB0 LB1 LB2
#define KEYS_R RT0 RT1 RT2 RT3 RT4  RM0 RM1 RM2 RM3 RM4  RB0 RB1 RB2

#undef THUMBS
#define THUMBS LH2 LH1 RH1 RH2

/* Layouts gate their reduced (3-key bottom) ZMK_BASE_LAYER on this. */
#define LUNA
