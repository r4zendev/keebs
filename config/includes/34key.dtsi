/* Standard 34-key setup.
 * Maps zmk-helpers 36-key labels to a 34-key matrix (no LH0/RH0). */

#include <zmk-helpers/key-labels/36.h>

#undef LH0
#undef LH1
#undef LH2
#undef RH0
#undef RH1
#undef RH2
#define LH2 30
#define LH1 31
#define RH1 32
#define RH2 33

#undef THUMBS
