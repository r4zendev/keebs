## config/modules/layer-chord/Kconfig
```kconfig
DT_COMPAT_ZMK_BEHAVIOR_LAYER_CHORD := zmk,behavior-layer-chord

config ZMK_BEHAVIOR_LAYER_CHORD
    bool
    default $(dt_compat_enabled,$(DT_COMPAT_ZMK_BEHAVIOR_LAYER_CHORD))

DT_COMPAT_ZMK_BEHAVIOR_ALPHA_REPEAT := zmk,behavior-alpha-repeat

config ZMK_BEHAVIOR_ALPHA_REPEAT
    bool
    default $(dt_compat_enabled,$(DT_COMPAT_ZMK_BEHAVIOR_ALPHA_REPEAT))
```

## config/modules/layer-chord/dts/bindings/behaviors/zmk,behavior-layer-mod-chord.yaml
```yaml
description: Momentary layer and modifier chord with independent releases

compatible: "zmk,behavior-layer-mod-chord"

include: zero_param.yaml

properties:
  bindings:
    type: phandle-array
    required: true
  layer:
    type: int
    required: true
  layer-position:
    type: int
    required: true
  modifier-position:
    type: int
    required: true
```
