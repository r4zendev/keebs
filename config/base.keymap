/* Shared base keymap, included by all board-specific wrappers.
 * Override before including: THUMBS, LH_NONE/RH_NONE, SKIP_SYSTEM_LAYER. */

#include "includes/features.dtsi"
#include "includes/defines.dtsi"
#include "includes/layouts.dtsi"
#include "includes/macros.dtsi"
#include "includes/behaviors.dtsi"
#include "includes/thumbs.dtsi"
#include "includes/leader.dtsi"
#include "includes/combos.dtsi"

#ifndef ZMK_BASE_LAYER
#define ZMK_BASE_LAYER(name, LT, RT, LM, RM, LB, RB, LH, RH) \
    ZMK_LAYER(name, LT RT LM RM LB RB LH RH)
#endif

#include "includes/layers/alpha_graphite.dtsi"
#include "includes/layers/alpha_vestnik.dtsi"
/* alpha_bunya.dtsi, alpha_dusk.dtsi kept on disk, not compiled in. */

#include "includes/layers/symbol.dtsi"
#include "includes/layers/nav.dtsi"
#include "includes/layers/num.dtsi"
#include "includes/layers/vestnik_x.dtsi"
#include "includes/layers/mouse.dtsi"

#ifndef SKIP_SYSTEM_LAYER
#include "includes/layers/system.dtsi"
#endif
