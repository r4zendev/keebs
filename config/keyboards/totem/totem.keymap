/* TOTEM wrapper.
 *
 * The TOTEM exposes 38 positions: 3x5 alphas per half, one extra outer
 * pinky key on the bottom row per half, and 3 thumbs per half. This maps
 * the shared layout onto the alphas and the inner two thumbs per half;
 * the outer bottom-row keys and outer thumbs are unused.
 */

#define ___ &none

#define LT4  0
#define LT3  1
#define LT2  2
#define LT1  3
#define LT0  4

#define RT0  5
#define RT1  6
#define RT2  7
#define RT3  8
#define RT4  9

#define LM4 10
#define LM3 11
#define LM2 12
#define LM1 13
#define LM0 14

#define RM0 15
#define RM1 16
#define RM2 17
#define RM3 18
#define RM4 19

#define LB4 21
#define LB3 22
#define LB2 23
#define LB1 24
#define LB0 25

#define RB0 26
#define RB1 27
#define RB2 28
#define RB3 29
#define RB4 30

#define LH0 32
#define LH2 33
#define LH1 34

#define RH1 35
#define RH2 36
#define RH0 37

#define THUMBS LH2 LH1 LH0 RH0 RH1 RH2

#define LH_NONE &none
#define RH_NONE &none

#define TOTEM_CAT_(a, b) a ## b
#define TOTEM_CAT(a, b) TOTEM_CAT_(a, b)
#define TOTEM_LEFT_EXTRA(name) TOTEM_CAT(TOTEM_LEFT_EXTRA_, name)
#define TOTEM_RIGHT_EXTRA(name) TOTEM_CAT(TOTEM_RIGHT_EXTRA_, name)

#define TOTEM_LEFT_EXTRA_Graphite &none
#define TOTEM_RIGHT_EXTRA_Graphite &none
#define TOTEM_LEFT_EXTRA_VestnikDm &kp COMMA
#define TOTEM_RIGHT_EXTRA_VestnikDm &kp DOT
#define TOTEM_LEFT_EXTRA_Symbol &none
#define TOTEM_RIGHT_EXTRA_Symbol &none
#define TOTEM_LEFT_EXTRA_Nav &none
#define TOTEM_RIGHT_EXTRA_Nav &none
#define TOTEM_LEFT_EXTRA_Num &none
#define TOTEM_RIGHT_EXTRA_Num &none
#define TOTEM_LEFT_EXTRA_VestnikX &none
#define TOTEM_RIGHT_EXTRA_VestnikX &none
#define TOTEM_LEFT_EXTRA_Mouse &none
#define TOTEM_RIGHT_EXTRA_Mouse &none
#define TOTEM_LEFT_EXTRA_System &none
#define TOTEM_RIGHT_EXTRA_System &none

#define ZMK_BASE_LAYER(name, LT, RT, LM, RM, LB, RB, LH, RH) \
    ZMK_LAYER(name, \
        LT RT \
        LM RM \
        TOTEM_LEFT_EXTRA(name) LB RB TOTEM_RIGHT_EXTRA(name) \
        LH RH \
    )

#include "base.keymap"
