/* Lintilla 34-key wrapper using the shared base keymap.
 *
 * Use the 5x3 alpha block on each half plus the two thumbs nearest the main
 * alpha block on each side:
 * - skip the isolated top corner keys
 * - skip the extra outer alpha key on the top/middle rows
 * - skip the outermost thumb on each half
 */

#define ___ &none

#define LT4  3
#define LT3  4
#define LT2  5
#define LT1  6
#define LT0  7

#define RT0  8
#define RT1  9
#define RT2 10
#define RT3 11
#define RT4 12

#define LM4 15
#define LM3 16
#define LM2 17
#define LM1 18
#define LM0 19

#define RM0 20
#define RM1 21
#define RM2 22
#define RM3 23
#define RM4 24

#define LB4 26
#define LB3 27
#define LB2 28
#define LB1 29
#define LB0 30

#define RB0 31
#define RB1 32
#define RB2 33
#define RB3 34
#define RB4 35

#define LH2 36
#define LH1 37
#define RH1 40
#define RH2 41

#define THUMBS LH2 LH1 RH1 RH2

/* Lintilla's full matrix is 42 positions:
 * - two isolated top corner keys are unused
 * - top/home rows use the inner 5-key alpha block per half
 * - bottom row uses all 5 alpha keys per half
 * - thumb row uses the two keys nearest each hand, leaving the center pair unused
 */
#define ZMK_BASE_LAYER(name, LT, RT, LM, RM, LB, RB, LH, RH) \
    ZMK_LAYER(name, \
        ___                                                                 ___ \
        ___ LT                                                              RT ___ \
        ___ LM                                                              RM ___ \
            LB                                                              RB     \
                                LH ___ ___ RH                               \
    )

#include "base.keymap"
