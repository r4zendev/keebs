/* Charybdis Nano wrapper: 5 columns per hand, 3 left thumbs, 2-3 right thumbs. */

#include <zmk-helpers/key-labels/36.h>

#undef THUMBS
#define THUMBS LH1 LH0 RH0 RH1

#undef LH_NONE
#define LH_NONE &mo LAYER_Num

#undef RH_NONE
#define RH_NONE &kp ESC

#define LEADER_COMBO_KEYS LH2 RH1

#include "base.keymap"
