#define ___ &none

#define LT4  0
#define LT3  1
#define LT2  2
#define LT1  3
#define LT0  4

#define RT0  7
#define RT1  8
#define RT2  9
#define RT3 10
#define RT4 11

#define LM4 12
#define LM3 13
#define LM2 14
#define LM1 15
#define LM0 16

#define RM0 17
#define RM1 18
#define RM2 19
#define RM3 20
#define RM4 21

#define LB4 22
#define LB3 23
#define LB2 24
#define LB1 25
#define LB0 26

#define RB0 29
#define RB1 30
#define RB2 31
#define RB3 32
#define RB4 33

#define LH2 36
#define LH1 37
#define RH1 38
#define RH2 39

#define THUMBS LH2 LH1 RH1 RH2

#define ZMK_BASE_LAYER(name, LT, RT, LM, RM, LB, RB, LH, RH) \
    ZMK_LAYER(name, \
        LT ___       ___ RT \
        LM RM \
        LB ___       ___ RB \
        ___ ___ LH   RH ___ ___ \
    )

#include "base.keymap"
