/* KLOR wireless wrapper.
 *
 * The KLOR PCB exposes 44 positions. This wrapper maps the shared 34-key
 * layout onto:
 *   - the 5-key alpha row on each half
 *   - the inner five keys on the middle alpha rows
 *   - the inner five keys on the bottom alpha rows, skipping the center pair
 *   - the two inner thumb keys per half
 */

#define ___ &none

#define LT4  0
#define LT3  1
#define LT2  2
#define LT1  3
#define LT0  4

#define RT0  5
#define RT1  6
#define RT2  7
#define RT3  8
#define RT4  9

#define LM4 11
#define LM3 12
#define LM2 13
#define LM1 14
#define LM0 15

#define RM0 16
#define RM1 17
#define RM2 18
#define RM3 19
#define RM4 20

#define LB4 23
#define LB3 24
#define LB2 25
#define LB1 26
#define LB0 27

#define RB0 30
#define RB1 31
#define RB2 32
#define RB3 33
#define RB4 34

#define LH2 37
#define LH1 38
#define RH1 41
#define RH2 42

#define THUMBS LH2 LH1 RH1 RH2

#define ZMK_BASE_LAYER(name, LT, RT, LM, RM, LB, RB, LH, RH) \
    ZMK_LAYER(name, \
        LT RT \
        ___ LM RM ___ \
        ___ LB ___ ___ RB ___ \
        ___ LH ___ ___ RH ___ \
    )

#include "base.keymap"
