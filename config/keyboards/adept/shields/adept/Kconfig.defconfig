## config/keyboards/adept/shields/adept/Kconfig.defconfig
```kconfig
if SHIELD_ADEPT

config ZMK_KEYBOARD_NAME
    default "AdeptBLE"

config ZMK_BLE
    default y

config ZMK_USB
    default y

config SPI
    default y

endif
```

## config/keyboards/ansic/shields/ansic/Kconfig.defconfig
```kconfig
if SHIELD_ANSIC_LEFT || SHIELD_ANSIC_RIGHT

config ZMK_KEYBOARD_NAME
    default "ANSIC"

endif
```

## config/keyboards/ansic/shields/ansic/Kconfig.shield
```kconfig
config SHIELD_ANSIC_LEFT
    def_bool $(shields_list_contains,ansic_left)
    select ZMK_SPLIT
    select ZMK_SPLIT_ROLE_CENTRAL

config SHIELD_ANSIC_RIGHT
    def_bool $(shields_list_contains,ansic_right)
    select ZMK_SPLIT
```

## config/keyboards/cantor_ble/shields/cantor_ble/Kconfig.defconfig
```kconfig
if SHIELD_CANTOR_BLE_LEFT

config ZMK_KEYBOARD_NAME
    default "Cantor BLE"

config ZMK_SPLIT_ROLE_CENTRAL
    default y

config ZMK_USB
    default y

endif

if SHIELD_CANTOR_BLE_LEFT || SHIELD_CANTOR_BLE_RIGHT

config ZMK_SPLIT
    default y

endif

config ZMK_BLE
    default y
```

## config/keyboards/cantor_ble/shields/cantor_ble/Kconfig.shield
```kconfig
config SHIELD_CANTOR_BLE_LEFT
    def_bool $(shields_list_contains,cantor_ble_left)

config SHIELD_CANTOR_BLE_RIGHT
    def_bool $(shields_list_contains,cantor_ble_right)
```

## config/keyboards/cantor_ble/shields/cantor_ble_diodeprobe/Kconfig.defconfig
```kconfig
if SHIELD_CANTOR_BLE_DIODEPROBE

config ZMK_KEYBOARD_NAME
    default "Cantor Dprobe"

config ZMK_BLE
    default y

endif
```

## config/keyboards/cantor_ble/shields/cantor_ble_diodeprobe/Kconfig.shield
```kconfig
config SHIELD_CANTOR_BLE_DIODEPROBE
    def_bool $(shields_list_contains,cantor_ble_diodeprobe)
```

## config/keyboards/cantor_ble/shields/cantor_ble_pinprobe/Kconfig.defconfig
```kconfig
if SHIELD_CANTOR_BLE_PINPROBE

config ZMK_KEYBOARD_NAME
    default "Cantor Pinprobe"

config ZMK_BLE
    default y

endif
```

## config/keyboards/cantor_ble/shields/cantor_ble_pinprobe/Kconfig.shield
```kconfig
config SHIELD_CANTOR_BLE_PINPROBE
    def_bool $(shields_list_contains,cantor_ble_pinprobe)
```

## config/keyboards/charybdis_nano/shields/charybdis_nano/Kconfig.shield
```kconfig
config SHIELD_CHARYBDIS_NANO_LEFT
    def_bool $(shields_list_contains,charybdis_nano_left)
    select ZMK_SPLIT

config SHIELD_CHARYBDIS_NANO_RIGHT
    def_bool $(shields_list_contains,charybdis_nano_right)
    select ZMK_SPLIT
    select ZMK_SPLIT_ROLE_CENTRAL
```

## config/keyboards/dartyl/shields/dartyl/Kconfig.defconfig
```kconfig
if SHIELD_DARTYL_LEFT || SHIELD_DARTYL_RIGHT

config ZMK_KEYBOARD_NAME
    default "Dartyl"

endif
```

## config/keyboards/dartyl/shields/dartyl/Kconfig.shield
```kconfig
config SHIELD_DARTYL_LEFT
    def_bool $(shields_list_contains,dartyl_left)
    select ZMK_SPLIT
    select ZMK_SPLIT_ROLE_CENTRAL

config SHIELD_DARTYL_RIGHT
    def_bool $(shields_list_contains,dartyl_right)
    select ZMK_SPLIT
```

## config/keyboards/hillside/shields/hillside/Kconfig.defconfig
```kconfig
if SHIELD_HILLSIDE_LEFT

config ZMK_KEYBOARD_NAME
    default "Hillside D50"

config ZMK_SPLIT_ROLE_CENTRAL
    default y

endif

if SHIELD_HILLSIDE_LEFT || SHIELD_HILLSIDE_RIGHT

config ZMK_SPLIT
    default y

endif
```

## config/keyboards/klor/shields/klor/Kconfig.shield
```kconfig
config SHIELD_KLOR_LEFT
    def_bool $(shields_list_contains,klor_left)
    select ZMK_SPLIT
    select ZMK_SPLIT_ROLE_CENTRAL

config SHIELD_KLOR_RIGHT
    def_bool $(shields_list_contains,klor_right)
    select ZMK_SPLIT
```

## config/keyboards/klotz/shields/klotz/Kconfig.defconfig
```kconfig
if SHIELD_KLOTZ_LEFT || SHIELD_KLOTZ_RIGHT

config ZMK_KEYBOARD_NAME
    default "KLOTZ"

if ZMK_BACKLIGHT

config PWM
    default y

config LED_PWM
    default y

endif # ZMK_BACKLIGHT

endif
```

## config/keyboards/klotz/shields/klotz/Kconfig.shield
```kconfig
config SHIELD_KLOTZ_LEFT
    def_bool $(shields_list_contains,klotz_left)
    select ZMK_SPLIT
    select ZMK_SPLIT_ROLE_CENTRAL

config SHIELD_KLOTZ_RIGHT
    def_bool $(shields_list_contains,klotz_right)
    select ZMK_SPLIT
```

## config/keyboards/lambbt/shields/lambbt/Kconfig.defconfig
```kconfig
if SHIELD_LAMBBT_LEFT || SHIELD_LAMBBT_RIGHT

config ZMK_KEYBOARD_NAME
    default "LambBT"

endif
```

## config/keyboards/lambbt/shields/lambbt/Kconfig.shield
```kconfig
config SHIELD_LAMBBT_LEFT
    def_bool $(shields_list_contains,lambbt_left)
    select ZMK_SPLIT
    select ZMK_SPLIT_ROLE_CENTRAL

config SHIELD_LAMBBT_RIGHT
    def_bool $(shields_list_contains,lambbt_right)
    select ZMK_SPLIT
```

## config/keyboards/piantor_pro/shields/piantor_pro/Kconfig.defconfig
```kconfig
if SHIELD_PIANTOR_PRO_LEFT || SHIELD_PIANTOR_PRO_RIGHT

config ZMK_KEYBOARD_NAME
    default "Piantor Pro"

endif
```

## config/keyboards/piantor_pro/shields/piantor_pro/Kconfig.shield
```kconfig
config SHIELD_PIANTOR_PRO_LEFT
    def_bool $(shields_list_contains,piantor_pro_left)
    select ZMK_SPLIT
    select ZMK_SPLIT_ROLE_CENTRAL

config SHIELD_PIANTOR_PRO_RIGHT
    def_bool $(shields_list_contains,piantor_pro_right)
    select ZMK_SPLIT
```

## config/keyboards/totem/shields/totem/Kconfig.defconfig
```kconfig
if SHIELD_TOTEM_LEFT

config ZMK_KEYBOARD_NAME
    default "TOTEM"

config ZMK_SPLIT_ROLE_CENTRAL
    default y

config ZMK_USB
    default y

endif

if SHIELD_TOTEM_LEFT || SHIELD_TOTEM_RIGHT

config ZMK_SPLIT
    default y

endif

config ZMK_BLE
    default y
```

## config/keyboards/wysteria/shields/wysteria/Kconfig.defconfig
```kconfig
if SHIELD_WYSTERIA_LEFT || SHIELD_WYSTERIA_RIGHT

config ZMK_KEYBOARD_NAME
    default "Wysteria"

endif
```

## config/keyboards/wysteria/shields/wysteria/Kconfig.shield
```kconfig
config SHIELD_WYSTERIA_LEFT
    def_bool $(shields_list_contains,wysteria_left)
    select ZMK_SPLIT
    select ZMK_SPLIT_ROLE_CENTRAL

config SHIELD_WYSTERIA_RIGHT
    def_bool $(shields_list_contains,wysteria_right)
    select ZMK_SPLIT
```
