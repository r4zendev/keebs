/* Cantor BLE wrapper.
 *
 * The Cantor BLE exposes 42 positions (3x6 + 3 thumbs per half). This maps
 * the shared layout onto the inner five columns and the inner two thumbs
 * per half; the outer pinky columns and outer thumbs are unused.
 */

#define ___ &none

#define LT4  1
#define LT3  2
#define LT2  3
#define LT1  4
#define LT0  5

#define RT0  6
#define RT1  7
#define RT2  8
#define RT3  9
#define RT4 10

#define LM4 13
#define LM3 14
#define LM2 15
#define LM1 16
#define LM0 17

#define RM0 18
#define RM1 19
#define RM2 20
#define RM3 21
#define RM4 22

#define LB4 25
#define LB3 26
#define LB2 27
#define LB1 28
#define LB0 29

#define RB0 30
#define RB1 31
#define RB2 32
#define RB3 33
#define RB4 34

#define LH0 36
#define LH2 37
#define LH1 38

#define RH1 39
#define RH2 40
#define RH0 41

#define THUMBS LH2 LH1 LH0 RH0 RH1 RH2

#define LH_NONE &none
#define RH_NONE &none

#define ZMK_BASE_LAYER(name, LT, RT, LM, RM, LB, RB, LH, RH) \
    ZMK_LAYER(name, \
        ___ LT RT ___ \
        ___ LM RM ___ \
        ___ LB RB ___ \
        LH RH \
    )

#include "base.keymap"
