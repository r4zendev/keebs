/* KLOTZ 34-key wrapper with encoder volume bindings. */

#include <dt-bindings/zmk/backlight.h>

#include "includes/34key.dtsi"

#define KLOTZ_ENCODER_BINDINGS &inc_dec_kp C_VOL_UP C_VOL_DN
#define SYS_LIGHT_TOG &bl BL_TOG
#define SYS_LIGHT_DEC &bl BL_DEC
#define SYS_LIGHT_INC &bl BL_INC
#define ZMK_BASE_LAYER(name, LT, RT, LM, RM, LB, RB, LH, RH) \
    ZMK_LAYER(name, LT RT LM RM LB RB LH RH, KLOTZ_ENCODER_BINDINGS)

#include "base.keymap"
